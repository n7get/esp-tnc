## main/Kconfig.projbuild
```kconfig
menu "ESP-TNC BBS"

    config TNC_ENABLE_LOG_TCP_SERVER
        bool "Enable AX.25 log TCP server"
        default y
        default n if !SPIRAM
        help
            Starts the optional AX.25 log TCP server used for remote log
            streaming. This consumes additional heap, queues, and a task per
            client. On builds without PSRAM it is often better left disabled.

    config TNC_ENABLE_MONITOR_TCP_SERVER
        bool "Enable AX.25 monitor TCP server"
        default y
        default n if !SPIRAM
        help
            Starts the AX.25 monitor TCP server used to stream monitor traffic
            to external clients. Disable this to reduce memory use when remote
            monitoring is not needed.

    config TNC_ENABLE_BEACON_SERVICE
        bool "Enable AX.25 beacon service"
        default y
        default n if !SPIRAM
        help
            Enables the runtime beacon service. Disable this to remove beacon
            support entirely, regardless of runtime beacon configuration.

    config TNC_ENABLE_DIGIPEATER_SERVICE
        bool "Enable AX.25 digipeater service"
        default y
        default n if !SPIRAM
        help
            Enables the runtime digipeater service. Disable this to prevent the
            digipeater from starting, even if `digi.callsign` is configured.

    config TNC_PWR_LED_GPIO
        int "Power LED GPIO pin"
        default 0
        range 0 48
        help
            Default GPIO used for the power LED. This value also seeds
            led.pwr_pin in runtime AX.25 config.

    config TNC_BBS_LED_GPIO
        int "BBS LED GPIO pin"
        default 0
        range 0 48
        help
            Default GPIO used for the BBS status LED. This value also seeds
            led.bbs_pin in runtime AX.25 config.

    config BBS_SYSOP_NAME
        string "SYSOP Name"
        default "SYSOP"

    config BBS_GREETING_TEXT
        string "Greeting text"
        default "Welcome to ESP-TNC BBS"

    config BBS_PROMPT_TEXT
        string "Command prompt text"
        default "BBS READY>"

    config BBS_CONFIG_PROMPT_TEXT
        string "Config mode prompt text"
        default "CONFIG READY>"

    config BBS_TERMINAL_PROMPT_TEXT
        string "Terminal mode prompt text"
        default "TERM READY>"

    config BBS_VERSION_TEXT
        string "BBS version string"
        default "ESP-TNC BBS 0.1"

    config BBS_PARTITION_LABEL
        string "LittleFS partition label"
        default "bbs_data"

    config BBS_MAX_MESSAGES
        int "Maximum number of stored messages"
        default 100
        range 10 250

    config BBS_MAX_BODY_LEN
        int "Maximum message body length"
        default 1024
        range 256 4096

    config BBS_CMD_TRACE_LOG
        bool "Log BBS commands and one-line response summaries"
        default n
        help
            When enabled, logs one CMD line and one RESP line per processed
            command to help diagnose script behavior and command flow.

    config BBS_SYSOP_CHALLENGE_TIMEOUT_SEC
        int "SYSOP challenge timeout (seconds)"
        default 300
        range 30 86400

    config BBS_SYSOP_SESSION_TIMEOUT_SEC
        int "SYSOP authenticated session timeout (seconds)"
        default 600
        range 30 86400

    config BBS_SYSOP_LOCKOUT_SEC
        int "SYSOP lockout duration after max failures (seconds)"
        default 900
        range 30 86400

    config BBS_SYSOP_MAX_ATTEMPTS
        int "SYSOP max failed attempts per session"
        default 3
        range 1 20

    config BBS_SYSOP_SECRET_MIN_LEN
        int "SYSOP secret minimum length"
        default 16
        range 1 256

    config BBS_SYSOP_SECRET_MAX_LEN
        int "SYSOP secret maximum length"
        default 256
        range 16 256

endmenu
```

## sdkconfig.defaults
```kconfig
CONFIG_PARTITION_TABLE_CUSTOM=y
CONFIG_PARTITION_TABLE_CUSTOM_FILENAME="partitions.csv"
CONFIG_SPIRAM=y
CONFIG_AX25_WIFI_STA_HOSTNAME_DEFAULT="esp-tnc"
CONFIG_AX25_AGWPE_SERVER_TASK_STACK_SIZE=4096
CONFIG_AX25_ROUTER_PORT_TASK_STACK_SIZE=6144
CONFIG_AX25_PHY_TCP_SERVER_ACCEPT_TASK_STACK_SIZE=4096
CONFIG_COMPILER_STACK_CHECK_MODE_STRONG=y
CONFIG_FREERTOS_WATCHPOINT_END_OF_STACK=y
CONFIG_FREERTOS_TIMER_TASK_STACK_DEPTH=4096
CONFIG_HEAP_POISONING_COMPREHENSIVE=y
CONFIG_HEAP_ABORT_WHEN_ALLOCATION_FAILS=y
CONFIG_SPIRAM_MALLOC_ALWAYSINTERNAL=4096
CONFIG_SPIRAM_MALLOC_RESERVE_INTERNAL=65536

# Trim Wi-Fi RAM use conservatively before touching interoperability-sensitive
# features like AMPDU or WPA2 crypto support.
CONFIG_ESP_WIFI_STATIC_RX_BUFFER_NUM=8
CONFIG_ESP_WIFI_DYNAMIC_RX_BUFFER_NUM=16
CONFIG_ESP_WIFI_DYNAMIC_TX_BUFFER_NUM=16
CONFIG_ESP_WIFI_RX_MGMT_BUF_NUM_DEF=4
CONFIG_ESP_WIFI_MGMT_SBUF_NUM=16

# Keep Wi-Fi auth limited to WPA2-Personal/PSK features.
# CONFIG_ESP_WIFI_ENABLE_WPA3_SAE is not set
# CONFIG_ESP_WIFI_ENABLE_SAE_PK is not set
# CONFIG_ESP_WIFI_ENABLE_SAE_H2E is not set
# CONFIG_ESP_WIFI_SOFTAP_SAE_SUPPORT is not set
# CONFIG_ESP_WIFI_ENABLE_WPA3_OWE_STA is not set
# CONFIG_ESP_WIFI_ENTERPRISE_SUPPORT is not set
# CONFIG_ESP_WIFI_WAPI_PSK is not set
# CONFIG_ESP_WIFI_SUITE_B_192 is not set
# CONFIG_ESP_WIFI_DPP_SUPPORT is not set

#
# Addational logging
#
CONFIG_AX25_ROUTER_LOG_FRAMES=y
CONFIG_AX25_ROUTER_LOG_PORT_STATUS=y
CONFIG_AX25_CONN_LOG_FRAMES=y
CONFIG_AX25_CONN_LOG_DROPPED_FRAMES=y
CONFIG_AX25_PHY_UART_LOG_FRAMES=y
```

## test_bbs/main/Kconfig.projbuild
```kconfig
menu "AX.25 BBS Tester Configuration"

    config TEST_BBS_WIFI_SSID
        string "WiFi SSID"
        default "ESP-AX25"


    config TEST_BBS_WIFI_PASSWORD
        string "WiFi Password"
        default ""

    config TEST_BBS_WIFI_AP_SSID
        string "Fallback AP SSID"
        default "ESP-AX25-TEST"

    config TEST_BBS_WIFI_AP_PASSWORD
        string "Fallback AP Password"
        default ""

    choice TEST_BBS_KISS_TRANSPORT
        prompt "KISS transport mode"
        default TEST_BBS_KISS_TCP
        help
            Select whether to use TCP or UART KISS transport.
            TCP requires WiFi connectivity; UART requires a TNC on UART.

        config TEST_BBS_KISS_TCP
            bool "TCP KISS (WiFi)"

        config TEST_BBS_KISS_UART
            bool "UART KISS"
    endchoice

    # TCP KISS configuration
    config TEST_BBS_REMOTE_HOST
        string "BBS KISS TCP Host"
        default "192.168.4.1"
        depends on TEST_BBS_KISS_TCP
        help
            Hostname or IPv4 address of the BBS KISS TCP server.
            The default assumes the BBS is running in fallback AP mode,
            which uses 192.168.4.1 on SSID ESP-AX25 unless overridden by
            runtime ax25_config settings.

    config TEST_BBS_REMOTE_TCP_PORT
        int "BBS KISS TCP Port"
        default 8100
        range 1 65535
        depends on TEST_BBS_KISS_TCP

    # UART KISS configuration
    config TEST_BBS_UART_NUMBER
        int "UART port number"
        default 1
        range 0 2
        depends on TEST_BBS_KISS_UART
        help
            UART port: 0–2 (typically 1 for TNC).

    choice TEST_BBS_UART_BAUD_CHOICE
        prompt "UART baud rate"
        default TEST_BBS_UART_BAUD_57600
        depends on TEST_BBS_KISS_UART
        help
            Select a supported UART baud rate for TNC communication.

        config TEST_BBS_UART_BAUD_1200
            bool "1200"

        config TEST_BBS_UART_BAUD_2400
            bool "2400"

        config TEST_BBS_UART_BAUD_4800
            bool "4800"

        config TEST_BBS_UART_BAUD_9600
            bool "9600"

        config TEST_BBS_UART_BAUD_19200
            bool "19200"

        config TEST_BBS_UART_BAUD_38400
            bool "38400"

        config TEST_BBS_UART_BAUD_57600
            bool "57600"

        config TEST_BBS_UART_BAUD_115200
            bool "115200"

        config TEST_BBS_UART_BAUD_230400
            bool "230400"

        config TEST_BBS_UART_BAUD_460800
            bool "460800"

        config TEST_BBS_UART_BAUD_921600
            bool "921600"
    endchoice

    config TEST_BBS_UART_BAUD
        int
        depends on TEST_BBS_KISS_UART
        default 1200 if TEST_BBS_UART_BAUD_1200
        default 2400 if TEST_BBS_UART_BAUD_2400
        default 4800 if TEST_BBS_UART_BAUD_4800
        default 9600 if TEST_BBS_UART_BAUD_9600
        default 19200 if TEST_BBS_UART_BAUD_19200
        default 38400 if TEST_BBS_UART_BAUD_38400
        default 57600 if TEST_BBS_UART_BAUD_57600
        default 115200 if TEST_BBS_UART_BAUD_115200
        default 230400 if TEST_BBS_UART_BAUD_230400
        default 460800 if TEST_BBS_UART_BAUD_460800
        default 921600 if TEST_BBS_UART_BAUD_921600

    config TEST_BBS_UART_TXD_PIN
        int "UART TXD (to TNC RXD) pin"
        default 6
        range 0 46
        depends on TEST_BBS_KISS_UART

    config TEST_BBS_UART_RXD_PIN
        int "UART RXD (from TNC TXD) pin"
        default 7
        range 0 46
        depends on TEST_BBS_KISS_UART

    # Common callsign configuration
    config TEST_BBS_LOCAL_CALLSIGN
        string "Tester AX.25 callsign"
        default "N0TST-1"

    config TEST_BBS_REMOTE_CALLSIGN
        string "BBS AX.25 callsign"
        default "N0CALL-1"

    config TEST_BBS_SYSOP_SECRET
        string "BBS SYSOP secret for CONFIG test"
        default ""
        help
            Leave empty to test CONFIG entry without authentication.
            Set this to the same SYSOP secret used by the BBS under test
            to validate the authenticated CONFIG challenge/response flow.

    config TEST_BBS_CONNECT_TIMEOUT_MS
        int "Connection timeout (ms)"
        default 60000
        range 1000 300000

    config TEST_BBS_STEP_TIMEOUT_MS
        int "Per-step timeout (ms)"
        default 20000
        range 1000 120000

endmenu
```

## test_bbs/sdkconfig.defaults
```kconfig
CONFIG_PARTITION_TABLE_SINGLE_APP=y
CONFIG_ESP_MAIN_TASK_STACK_SIZE=8192
CONFIG_AX25_ROUTER_PORT_TASK_STACK_SIZE=6144
CONFIG_FREERTOS_HZ=1000
CONFIG_ESP_CONSOLE_USB_SERIAL_JTAG=y
CONFIG_TEST_BBS_WIFI_SSID="ESP-AX25-BBS"
```

## test_servers/main/Kconfig.projbuild
```kconfig
menu "AX.25 Test Server Configuration"

    config TEST_SERVER_LOCAL_CALLSIGN
        string "Local Callsign"
        default "N0CALL"
        help
            AX.25 callsign used by this test client.

    config TEST_SERVER_REMOTE_CALLSIGN
        string "Remote Callsign"
        default "N0CALL-1"
        help
            Remote BBS callsign on the target esp-tnc.

    config TEST_SERVER_TARGET_HOST
        string "Target Host/IP"
        default "192.168.4.1"
        help
            Hostname or dotted-quad IP address of the target esp-tnc server.

    config TEST_SERVER_ENABLE_KISS_CLIENT
        bool "Enable KISS-over-TCP client"
        default y
        help
            Enable the TCP KISS transport path.

    config TEST_SERVER_KISS_PORT
        int "KISS TCP Port"
        default 8100
        range 1 65535
        depends on TEST_SERVER_ENABLE_KISS_CLIENT
        help
            TCP port used by the target KISS server.

    config TEST_SERVER_ENABLE_AGWPE_CLIENT
        bool "Enable AGWPE-over-TCP client"
        default y
        help
            Enable the TCP AGWPE transport path.

    config TEST_SERVER_AGWPE_PORT
        int "AGWPE TCP Port"
        default 8000
        range 1 65535
        depends on TEST_SERVER_ENABLE_AGWPE_CLIENT
        help
            TCP port used by the target AGWPE server.

    config TEST_SERVER_SESSION_COUNT
        int "Session Count"
        default 2
        range 1 100
        help
            Number of BBS sessions to run. When both transports are enabled,
            sessions alternate between KISS and AGWPE.

    config TEST_SERVER_CONNECT_TIMEOUT_MS
        int "Connect timeout (ms)"
        default 45000
        range 1000 300000
        help
            Maximum time to wait for TCP and AX.25 or AGWPE connect events.

    config TEST_SERVER_READ_TIMEOUT_MS
        int "Prompt read timeout (ms)"
        default 120000
        range 1000 600000
        help
            Maximum time to wait for each configured BBS prompt.

    config TEST_SERVER_PROMPT_PREFIX
        string "BBS prompt prefix"
        default "BBS READY>"
        help
            Prefix used to detect the BBS prompt. A received line matches
            when it starts with this string.

    config TEST_SERVER_EXERCISE_HEARD_LIST
        bool "Exercise heard-list command"
        default y
        help
            Send the `j` command after the first prompt and wait for the next
            prompt. Disable this to keep the session connected but skip the
            heard-list exercise while additional BBS test steps are added.

    config TEST_SERVER_WIFI_SSID
        string "Wi-Fi STA SSID"
        default ""
        help
            Station SSID used to reach the target esp-tnc.

    config TEST_SERVER_WIFI_PASSWORD
        string "Wi-Fi STA Password"
        default ""
        help
            Station password used to reach the target esp-tnc.

    config TEST_SERVER_WIFI_AP_SSID
        string "Fallback AP SSID"
        default "esp-ax25-test"
        help
            Access point SSID used when no station SSID is configured.

    config TEST_SERVER_WIFI_AP_PASSWORD
        string "Fallback AP Password"
        default ""
        help
            Access point password used when no station SSID is configured.

endmenu
```
